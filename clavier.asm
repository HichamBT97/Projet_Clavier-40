list p=16f877A , r=dec  

include <p16f877A.inc>  

__CONFIG H'3F39'

org 0x00
	BANKSEL 20H;
	RESULTAT EQU 20H 
	ANCIEN EQU 21H
	CBLOCK 0x70
	N0, N1, N2, N3, N4, N5, N6, N7, N8, N9, CL, ADD, SOUS, MUL, DIV, EGG
	ENDC
	
	MOVLW 0D7H;
	MOVWF N0;
	MOVLW 0EBH;
	MOVWF N1;
	MOVLW 0DBH;
	MOVWF N2;
	MOVLW 0BBH;
	MOVWF N3;
	MOVLW 0EDH;
	MOVWF N4;
	MOVLW 0DDH;
	MOVWF N5;
	MOVLW 0BDH;
	MOVWF N6;
	MOVLW 0EEH;
	MOVWF N7;
	MOVLW 0DEH;
	MOVWF N8;
	MOVLW 0BEH;
	MOVWF N9;
	MOVLW 0E7H;
	MOVWF CL;
	MOVLW 077H;
	MOVWF ADD;
	MOVLW 07BH;
	MOVWF SOUS;
	MOVLW 07DH;
	MOVWF MUL;
	MOVLW 07EH;
	MOVWF DIV;
	MOVLW 0B7H;
	MOVWF EGG;
	

	BANKSEL TRISE;
	BCF TRISE,PSPMODE;
	BANKSEL TRISD;
	MOVLW 0F0H;
	MOVWF TRISD;
	MOVLW 00H;
	MOVWF TRISB;
	BANKSEL PORTB;
	MOVLW 00H;
	MOVWF PORTB;
	MOVWF ANCIEN;
	
DEBUT
	BANKSEL PORTD;
	MOVLW 0FEH;
	MOVWF PORTD;
	MOVF PORTD,W; 
	MOVWF RESULTAT;
	CALL SEE;
	MOVWF ANCIEN;
	MOVWF PORTB;
	BANKSEL PORTD;
	MOVLW 0DH;
	MOVWF PORTD;
	MOVF PORTD,W;
	MOVWF RESULTAT;
	CALL SEE;
	MOVWF ANCIEN;
	MOVWF PORTB;
	BANKSEL PORTD;
	MOVLW 0BH;
	MOVWF PORTD;
	MOVF PORTD,W;
	MOVWF RESULTAT;
	CALL SEE;
	MOVWF ANCIEN;
	MOVWF PORTB;
	BANKSEL PORTD;
	MOVLW 07H;
	MOVWF PORTD;
	MOVF PORTD,W;
	MOVWF RESULTAT;
	CALL SEE;
	MOVWF ANCIEN;
	MOVWF PORTB;
	
GOTO DEBUT

SEE
	MOVF RESULTAT,W;
	SUBWF N0,W;
	BTFSS STATUS,Z;
	GOTO F1;
	MOVLW 00H;
	RETURN;
F1	MOVF RESULTAT,W;
	SUBWF N1,W;
	BTFSS STATUS,Z;
	GOTO F2;
	MOVLW 01H;
	RETURN;
F2	MOVF RESULTAT,W;
	SUBWF N2,W;
	BTFSS STATUS,Z;
	GOTO F33;
	MOVLW 02H;
	RETURN;
F33	MOVF RESULTAT,W;
	SUBWF N3,W;
	BTFSS STATUS,Z;
	GOTO F3;
	MOVLW 03H;
	RETURN;
F3 	MOVF RESULTAT,W;
	SUBWF N4,W;
	BTFSS STATUS,Z;
	GOTO F4;
	MOVLW 04H;
	RETURN;
F4	MOVF RESULTAT,W;
	SUBWF N5,W;
	BTFSS STATUS,Z;
	GOTO F5;
	MOVLW 05H;
	RETURN;
F5	MOVF RESULTAT,W;
	SUBWF N6,W;
	BTFSS STATUS,Z;
	GOTO F6;
	MOVLW 06H;
	RETURN;
F6	MOVF RESULTAT,W;
	SUBWF N7,W;
	BTFSS STATUS,Z;
	GOTO F7;
	MOVLW 07H;
	RETURN;
F7	MOVF RESULTAT,W;
	SUBWF N8,W;
	BTFSS STATUS,Z;
	GOTO F8;
	MOVLW 08H;
	RETURN;
F8	MOVF RESULTAT,W;
	SUBWF N9,W;
	BTFSS STATUS,Z;
	GOTO F9;
	MOVLW 09H;
	RETURN;
F9	MOVF RESULTAT,W;
	SUBWF CL,W;
	BTFSS STATUS,Z;
	GOTO F10;
	MOVLW 0AH;
	RETURN;
F10	MOVF RESULTAT,W;
	SUBWF ADD,W;
	BTFSS STATUS,Z;
	GOTO F11;
	MOVLW 0BH;
	RETURN;
F11	MOVF RESULTAT,W;
	SUBWF SOUS,W;
	BTFSS STATUS,Z;
	GOTO F12;
	MOVLW 0CH;
	RETURN;
F12	MOVF RESULTAT,W;
	SUBWF MUL,W;
	BTFSS STATUS,Z;
	GOTO F13;
	MOVLW 0DH;
	RETURN;
F13	MOVF RESULTAT,W;
	SUBWF DIV,W;
	BTFSS STATUS,Z;
	GOTO F14;
	MOVLW 0EH;
	RETURN;
F14	MOVF RESULTAT,W;
	SUBWF EGG,W;
	BTFSS STATUS,Z;
	GOTO F15;
	MOVLW 0FH;
	RETURN;
F15	
	BANKSEL ANCIEN;
	MOVF ANCIEN,W;
	RETURN;

END